## main/Kconfig.projbuild
```kconfig
menu "MQTT config"

	config MQTT_HOST
	    string "MQTT Host"
		default "iot.eclipse.org"
	
	config MQTT_PORT
	    int "MQTT Port"
	    default 1883
	
	config MQTT_CLIENT_ID
	    string "MQTT Client ID"
	    default "ESP32"
	
	config MQTT_USERNAME
	    string "MQTT Username"
	
	config MQTT_PASSWORD
	    string "MQTT Password"
	
endmenu
```

## sdkconfig.defaults
```kconfig
CONFIG_ESPTOOLPY_BAUD_921600B=y
CONFIG_ESPTOOLPY_FLASHSIZE_4MB=y

CONFIG_ESP32_DEFAULT_CPU_FREQ_MHZ=160

CONFIG_PARTITION_TABLE_TWO_OTA=y

CONFIG_ESP_HTTP_CLIENT_ENABLE_HTTPS=y

CONFIG_HTTPD_MAX_REQ_HDR_LEN=512
CONFIG_HTTPD_MAX_URI_LEN=512

CONFIG_ESPHTTPD_ENABLED=y
CONFIG_ESPHTTPD_STACK_SIZE=4096
CONFIG_ESPHTTPD_PROC_AFFINITY=
CONFIG_ESPHTTPD_PROC_PRI=4
CONFIG_ESPHTTPD_SHUTDOWN_SUPPORT=
CONFIG_ESPHTTPD_CORS_SUPPORT=
CONFIG_ESPHTTPD_HTMLDIR="html/"
CONFIG_ESPHTTPD_USEUGLIFYJS=
CONFIG_ESPHTTPD_SO_REUSEADDR=
CONFIG_ESPHTTPD_SSL_SUPPORT=
CONFIG_ESPHTTPD_BACKLOG_SUPPORT=
CONFIG_ESPHTTPD_SANITIZE_URLS=y

CONFIG_LWIP_MAX_SOCKETS=16

CONFIG_LWIP_MAX_ACTIVE_TCP=16
CONFIG_LWIP_MAX_LISTENING_TCP=16
CONFIG_LWIP_MAX_UDP_PCBS=16

CONFIG_MQTT_PROTOCOL_311=y
CONFIG_MQTT_TRANSPORT_SSL=
CONFIG_MQTT_TRANSPORT_WEBSOCKET=
CONFIG_MQTT_USE_CUSTOM_CONFIG=
CONFIG_MQTT_TASK_CORE_SELECTION_ENABLED=
CONFIG_MQTT_CUSTOM_OUTBOX=
```
